## kernel/Kconfig
```kconfig
menu "XingLingHu"

config KSU
	tristate "XingLingHu function support"
	depends on KPROBES && EXT4_FS
	default y
	help
	  Enable kernel-level root privileges on Android System.
	  Requires CONFIG_KPROBES for kernel hooking support.
	  Requires CONFIG_EXT4_FS for `ext4_unregister_sysfs`.
	  GKI 2.0 (kernel 5.10+) and non-GKI (kernel 4.14, 4.19, 5.4, ...)
	  kernels are supported, so old 4.14 series devices can be patched
	  as well; non-GKI kernels must build this module themselves
	  (builtin or as a loadable kernelsu.ko for boot image patching).
	  To compile as a module, choose M here: the
	  module will be called kernelsu.

config KSU_DEBUG
	bool "XingLingHu debug mode"
	depends on KSU
	default n
	help
	  Enable XingLingHu debug mode.

config KSU_DISABLE_MANAGER
	bool "Disable XingLingHu manager integration"
	depends on KSU
	default n
	help
	  Disable manager APK detection and manager-specific handling.
	  Root will be used in place of manager-only functionality.

config KSU_DISABLE_POLICY
	bool "Disable XingLingHu policy profiles"
	depends on KSU
	default n
	help
	  Disable per-app root/non-root profile customization.
	  Escalation will always use the default full root profile, and
	  non-root handling will follow the global umount policy only.

config KSU_X86_PATCH_SYSCALL_DISPATCHER
	bool "Dynamically patch x64's hardened syscall dispatcher to support syscall hooks"
	depends on KSU && X86_64
	default n
	help
	  Dynamically patch x64's hardened syscall dispatcher to support syscall hooks. This is a
	  replacement for a kernel source code patch, and is useful for x86_64 LKM mode.

endmenu
```
